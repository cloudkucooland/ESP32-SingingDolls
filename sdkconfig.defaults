## sdkconfig.defaults
```kconfig
# Override some defaults so BT stack is enabled
# by default in this example
CONFIG_BT_ENABLED=y
CONFIG_BT_NIMBLE_ENABLED=y

CONFIG_BLE_CONN_MGR_ROLE_PERIPHERAL=y
CONFIG_BLE_MIDI_PROFILE=y

CONFIG_ENABLE_LEAF=y

# CONFIG_BTDM_CTRL_MODE_BLE_ONLY=y
# CONFIG_BTDM_CTRL_MODE_BR_EDR_ONLY=n
# CONFIG_BTDM_CTRL_MODE_BTDM=n
```
